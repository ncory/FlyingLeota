## firmware/main/Kconfig.projbuild
```kconfig
menu "Flying Leota"

    choice LEOTA_DRIVES
        prompt "Drives"
        default LEOTA_DRIVES_SIM
        help
            What the controller flies. Simulated flies the PC simulator's rig, inside the
            controller: the whole controller, screen and network run with no motors, for
            the bench.

        config LEOTA_DRIVES_SIM
            bool "Simulated rig (bench, no motors)"
        config LEOTA_DRIVES_STEPDIR
            bool "Closed-loop steppers (step/dir)"
        config LEOTA_DRIVES_ODRIVE
            bool "ODrive S1 over CAN"
    endchoice

    config LEOTA_DIR_INVERT_MASK
        int "Lines that run backwards (bit 0 = A ... bit 3 = D)"
        range 0 15
        default 0
        help
            Set a line's bit if paying line out turns its motor the wrong way.

    menu "Step/dir drives"
        depends on LEOTA_DRIVES_STEPDIR
        config LEOTA_STEPS_PER_REV
            int "Steps per motor revolution (as set on the drive)"
            default 3200
        config LEOTA_DRUM_UM_PER_REV
            int "Line per drum revolution, in micrometres (nominal)"
            default 157080
            help
                The drum's circumference plus the line's own thickness: 157080 for a 50 mm
                drum. Setup's line test measures the real figure.
        config LEOTA_STEP_PULSE_NS
            int "Step pulse width (ns)"
            range 1000 10000
            default 2500
        config LEOTA_MAX_STEP_KHZ
            int "Highest step rate (kHz)"
            range 1 200
            default 60
        config LEOTA_STEP_PIN_A
            int "Line A step GPIO (-1: none)"
            default -1
        config LEOTA_STEP_PIN_B
            int "Line B step GPIO (-1: none)"
            default -1
        config LEOTA_STEP_PIN_C
            int "Line C step GPIO (-1: none)"
            default -1
        config LEOTA_STEP_PIN_D
            int "Line D step GPIO (-1: none)"
            default -1
        config LEOTA_DIR_PIN_A
            int "Line A direction GPIO"
            default -1
        config LEOTA_DIR_PIN_B
            int "Line B direction GPIO"
            default -1
        config LEOTA_DIR_PIN_C
            int "Line C direction GPIO"
            default -1
        config LEOTA_DIR_PIN_D
            int "Line D direction GPIO"
            default -1
        config LEOTA_ALARM_PIN_A
            int "Line A drive alarm input GPIO (-1: none)"
            default -1
        config LEOTA_ALARM_PIN_B
            int "Line B drive alarm input GPIO (-1: none)"
            default -1
        config LEOTA_ALARM_PIN_C
            int "Line C drive alarm input GPIO (-1: none)"
            default -1
        config LEOTA_ALARM_PIN_D
            int "Line D drive alarm input GPIO (-1: none)"
            default -1
        config LEOTA_ALARM_ACTIVE_LOW
            bool "Drive alarms pull their input low"
            default y
    endmenu

    menu "ODrive (CAN)"
        depends on LEOTA_DRIVES_ODRIVE
        config LEOTA_CAN_TX_PIN
            int "CAN TX GPIO"
            default -1
        config LEOTA_CAN_RX_PIN
            int "CAN RX GPIO"
            default -1
        config LEOTA_CAN_BITRATE
            int "CAN bit rate"
            default 1000000
        config LEOTA_ODRIVE_NODE_BASE
            int "Node ID of line A's ODrive (B, C, D follow)"
            range 0 59
            default 0
        config LEOTA_ODRIVE_UM_PER_TURN
            int "Line per motor turn, in micrometres (nominal)"
            default 157080
    endmenu

    menu "Safety I/O"
        config LEOTA_ESTOP_PIN
            int "E-stop chain status input GPIO (-1: none)"
            default -1
            help
                Reads the safety relay's status: the chain is closed (healthy) when this
                input is at the level below. With real drives and no E-stop input, the
                controller treats the chain as open and won't arm.
        config LEOTA_ESTOP_OK_LEVEL
            int "Input level while the E-stop chain is closed"
            range 0 1
            default 1
        config LEOTA_KEY_PIN
            int "Local/Remote key switch input GPIO (-1: none)"
            default -1
        config LEOTA_KEY_REMOTE_LEVEL
            int "Key input level for Remote"
            range 0 1
            default 1
        config LEOTA_ENABLE_PIN
            int "Drive enable output GPIO (-1: none)"
            default -1
        config LEOTA_PUMP_PIN
            int "Watchdog charge pump output GPIO (-1: none)"
            default -1
            help
                Toggled every control cycle (500 Hz square wave) while the drives are
                enabled. A hung controller stops it, and the charge pump circuit drops the
                drives' enable.
        config LEOTA_BRAKE_PIN
            int "Brake release output GPIO (-1: none)"
            default -1
            help
                High releases the brakes (through a relay). Low, or no power, grips.
    endmenu

    menu "Load cells (HX711)"
        config LEOTA_HX711_SCK_PIN
            int "Shared clock GPIO (-1: no load cells)"
            default -1
        config LEOTA_HX711_DOUT_PIN_A
            int "Line A data GPIO"
            default -1
        config LEOTA_HX711_DOUT_PIN_B
            int "Line B data GPIO"
            default -1
        config LEOTA_HX711_DOUT_PIN_C
            int "Line C data GPIO"
            default -1
        config LEOTA_HX711_DOUT_PIN_D
            int "Line D data GPIO"
            default -1
        config LEOTA_HX711_COUNTS_PER_N
            int "Counts per newton (nominal, from the data sheet)"
            default 2000
            help
                Setup's line test measures each cell's real zero and scale.
    endmenu

    menu "Anemometer (RS-485 Modbus)"
        config LEOTA_WIND_UART
            int "UART"
            range 1 4
            default 2
        config LEOTA_WIND_TX_PIN
            int "TX GPIO (-1: no anemometer)"
            default -1
        config LEOTA_WIND_RX_PIN
            int "RX GPIO"
            default -1
        config LEOTA_WIND_DE_PIN
            int "Driver enable (DE/RE) GPIO"
            default -1
        config LEOTA_WIND_BAUD
            int "Baud rate"
            default 4800
        config LEOTA_WIND_ADDRESS
            int "Modbus address"
            range 1 247
            default 1
        config LEOTA_WIND_REGISTER
            int "Holding register with the wind speed"
            default 0
        config LEOTA_WIND_DIVISOR
            int "Register value per m/s"
            default 10
    endmenu

    menu "Ethernet"
        config LEOTA_ETH_MDC_PIN
            int "MDC GPIO"
            default 31
        config LEOTA_ETH_MDIO_PIN
            int "MDIO GPIO"
            default 52
        config LEOTA_ETH_PHY_RST_PIN
            int "PHY reset GPIO"
            default 51
        config LEOTA_ETH_PHY_ADDR
            int "PHY address"
            default 1
    endmenu

    config LEOTA_TIMEZONE
        string "Time zone (POSIX TZ) for the screen's clock"
        default "EST5EDT,M3.2.0,M11.1.0"
    config LEOTA_SNTP_SERVER
        string "Time server (empty: none)"
        default "pool.ntp.org"

endmenu
```
